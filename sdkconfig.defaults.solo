## sdkconfig.defaults.solo
```kconfig
# Default sdkconfig values for project
# Supported hardware:
#   - ESP32-SOLO-1

# Espressif IoT Development Framework Configuration
CONFIG_IDF_TARGET_ESP32=y

# Bootloader config
CONFIG_BOOTLOADER_APP_ROLLBACK_ENABLE=y
CONFIG_BOOTLOADER_APP_ANTI_ROLLBACK=y
CONFIG_BOOTLOADER_APP_SECURE_VERSION=0
CONFIG_BOOTLOADER_APP_SEC_VER_SIZE_EFUSE_FIELD=32

# Serial flasher config
# IO mode, frequency and baud don't seem to take effect, though
CONFIG_ESPTOOLPY_FLASHMODE_QIO=y
CONFIG_ESPTOOLPY_FLASHFREQ_80M=y
CONFIG_ESPTOOLPY_FLASHSIZE_4MB=y
CONFIG_ESPTOOLPY_FLASHSIZE_DETECT=y
CONFIG_ESPTOOLPY_BAUD_921600B=y

# Partition Table
CONFIG_PARTITION_TABLE_CUSTOM=y
CONFIG_PARTITION_TABLE_CUSTOM_FILENAME="partitions.csv"
CONFIG_PARTITION_TABLE_OFFSET=0xF000

# Google IoT Core Configuration
CONFIG_GIOT_PROJECT_ID="project_id"
CONFIG_GIOT_LOCATION="europe-west1"
CONFIG_GIOT_REGISTRY_ID="registry_id"

# mbedTLS
CONFIG_MBEDTLS_HAVE_TIME=y

# Newlib
CONFIG_NEWLIB_STDOUT_LINE_ENDING_LF=y
CONFIG_NEWLIB_STDIN_LINE_ENDING_LF=y
# GCP IoT Core client library fails login if set
#CONFIG_NEWLIB_NANO_FORMAT=y

# ESP32-specific
CONFIG_ESP32_DEFAULT_CPU_FREQ_240=y
# Use the 8.5 MHz oscillator
CONFIG_ESP32_RTC_CLK_SRC_INT_8MD256=y
CONFIG_ESP32_RTC_CLK_CAL_CYCLES=1024

# HTTP Server
CONFIG_HTTPD_MAX_REQ_HDR_LEN=2048

# FreeRTOS
CONFIG_FREERTOS_UNICORE=y
CONFIG_FREERTOS_USE_TRACE_FACILITY=y
CONFIG_FREERTOS_GENERATE_RUN_TIME_STATS=y

# LWIP
CONFIG_LWIP_LOCAL_HOSTNAME="beegram"

# ESP HTTPS server
CONFIG_ESP_HTTPS_SERVER_ENABLE=y
```
